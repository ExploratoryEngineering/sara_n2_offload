## CMakeLists.txt
```
cmake_minimum_required(VERSION 3.13.1)
include($ENV{ZEPHYR_BASE}/cmake/app/boilerplate.cmake NO_POLICY_SCOPE)
project(n2_offload)

FILE(GLOB app_sources src/*.c)
target_sources(app PRIVATE ${app_sources})
```

## prj.conf
```kconfig
CONFIG_LOG=y
CONFIG_NETWORKING=y
CONFIG_NET_SOCKETS=y
CONFIG_NET_SOCKETS_POSIX_NAMES=y
CONFIG_NET_SOCKETS_OFFLOAD=y
CONFIG_NET_IPV4=n
CONFIG_NET_IPV6=n
CONFIG_NET_UDP=y
CONFIG_NET_OFFLOAD=y
CONFIG_HAS_SEGGER_RTT=y
CONFIG_USE_SEGGER_RTT=y
CONFIG_RTT_CONSOLE=y
CONFIG_UART_CONSOLE=n
CONFIG_UART_INTERRUPT_DRIVEN=y
CONFIG_SERIAL=y
CONFIG_RING_BUFFER=y
CONFIG_HEAP_MEM_POOL_SIZE=8192
CONFIG_MAIN_STACK_SIZE=4096
CONFIG_SYSTEM_WORKQUEUE_STACK_SIZE=4096
CONFIG_HW_STACK_PROTECTION=y
# This is just for logging.
CONFIG_LOG_IMMEDIATE=n
CONFIG_LOG_STRDUP_BUF_COUNT=10
CONFIG_STDOUT_CONSOLE=y


CONFIG_COAP=y
# FOTA setup
CONFIG_LWM2M=y
CONFIG_LWM2M_IPSO_SUPPORT=n
CONFIG_NET_STATISTICS=n
#CONFIG_NET_CONFIG_PEER_IPV4_ADDR="172.16.15.14"
CONFIG_LWM2M_FIRMWARE_UPDATE_PULL_SUPPORT=y
CONFIG_LWM2M_FIRMWARE_UPDATE_OBJ_SUPPORT=y
CONFIG_LWM2M_RD_CLIENT_SUPPORT=y
CONFIG_LWM2M_ENGINE_DEFAULT_LIFETIME=1800
CONFIG_LWM2M_RD_CLIENT_SUPPORT_BOOTSTRAP=n
CONFIG_LWM2M_LOG_LEVEL_INF=y
CONFIG_DEBUG=n


# Flash
CONFIG_REBOOT=y
CONFIG_FLASH=y
CONFIG_FLASH_PAGE_LAYOUT=y
CONFIG_BOOTLOADER_MCUBOOT=y
CONFIG_IMG_MANAGER=y
CONFIG_MCUBOOT_IMG_MANAGER=y
CONFIG_MPU_ALLOW_FLASH_WRITE=y

# hansj

# Frame buffer
CONFIG_CHARACTER_FRAMEBUFFER=y
# I2C
CONFIG_I2C=y
# SPI
CONFIG_SPI=y
CONFIG_SPI_1=y
# GPIO
CONFIG_GPIO=y
CONFIG_HAS_HW_NRF_GPIO0=y
CONFIG_GPIO_NRFX=y
#UART
CONFIG_SERIAL=y
CONFIG_UART_INTERRUPT_DRIVEN=y
CONFIG_UART_0_NRF_UART=y
#THREADS
CONFIG_NUM_COOP_PRIORITIES=10
CONFIG_NUM_PREEMPT_PRIORITIES=10
#Floating point
CONFIG_NEWLIB_LIBC=n


# CoAP needs more time. Roundtrips are *slow* through the modem
#CONFIG_COAP_INIT_ACK_TIMEOUT=10000
CONFIG_COAP_INIT_ACK_TIMEOUT_MS=20000
CONFIG_LWM2M_COAP_BLOCK_SIZE=256
CONFIG_LWM2M_ENGINE_STACK_SIZE=4096
CONFIG_LWM2M_ENGINE_MAX_PENDING=5
CONFIG_LWM2M_RW_JSON_SUPPORT=n
CONFIG_LWM2M_SECURITY_INSTANCE_COUNT=1
CONFIG_LWM2M_SERVER_INSTANCE_COUNT=2
# This is an OH FOR FUCKS SAKE I DON'T NEED THIS
CONFIG_COAP_EXTENDED_OPTIONS_LEN=y
CONFIG_COAP_EXTENDED_OPTIONS_LEN_VALUE=17

#in the list of "i can save some space here"
CONFIG_LWM2M_NUM_ATTR=10

#In the list of "why is this included as default?"
CONFIG_CHARACTER_FRAMEBUFFER=n
CONFIG_NET_NATIVE=n
CONFIG_NET_NATIVE_UDP=n
CONFIG_NET_BUF_RX_COUNT=1
CONFIG_NET_BUF_TX_COUNT=1
CONFIG_NET_L2_DUMMY=y
CONFIG_NET_TX_STACK_SIZE=512
CONFIG_NET_RX_STACK_SIZE=512
```

## nrf52_pca10040.overlay
```dts
&uart0 {
    status = "okay";
	compatible = "nordic,nrf-uart";
	current-speed = <9600>;
	tx-pin = <6>;
	rx-pin = <8>;
};
```

## src/main.c
```c
/*
    Copyright 2020 Telenor Digital AS

    Licensed under the Apache License, Version 2.0 (the "License");
    you may not use this file except in compliance with the License.
    You may obtain a copy of the License at

    http://www.apache.org/licenses/LICENSE-2.0

    Unless required by applicable law or agreed to in writing, software
    distributed under the License is distributed on an "AS IS" BASIS,
    WITHOUT WARRANTIES OR CONDITIONS OF ANY KIND, either express or implied.
    See the License for the specific language governing permissions and
    limitations under the License.
*/

#include "config.h"
#include <stdio.h>

#include <zephyr.h>
#include <drivers/gpio.h>
#include <net/socket.h>
#include "fota.h"
#include "test_udp.h"
#include "test_coap.h"
#include "test_modem.h"

void testFOTA()
{
    // Initialize the application and run any self-tests before calling fota_init.
    // Otherwise, if initialization or self-tests fail after an update, reboot the system and the previous firmware image will be used.
    k_sleep(1000);
    int ret = fota_init();
    if (ret)
    {
        printf("fota_init: %d\n", ret);
        return;
    }
    printf("Returned from fota_init()\n");

     while (true)
    {
        k_sleep(5000);
    }
}

void main(void)
{

    printf("Start\n");

    testFOTA();

    printf("Halting firmware\n");
}
```

## src/fota.h
```c
#pragma once

// This is the reported manufacturer reported by the LwM2M client. It is an
// arbitrary string and will be exposed through the Horde API.
#define CLIENT_MANUFACTURER "Exploratory Engineering"

// This is the model number reported by the LwM2M client. It is an arbitrary
// string and will be exposed by the Horde API.
#define CLIENT_MODEL_NUMBER "EE-N2-00"

// This is the serial number reported by the LwM2M client. If you have some
// kind of serial number available you can use that, otherwise the IMEI (the
// ID for the cellular modem) or IMSI (The ID of the SIM in use)
#define CLIENT_SERIAL_NUMBER "FINAL"

// This is the version of the firmware. This must match the versions set on the
// images uploaded via the Horde API (at https://api.nbiot.engineering/)
#define CLIENT_FIRMWARE_VER "2.0.0"

int fota_init();
```

## src/test_coap.c
```c
#include "config.h"
#include <logging/log.h>
#define LOG_LEVEL APP_LOG_LEVEL
LOG_MODULE_REGISTER(coap_test);

#include <zephyr.h>
#include <stdio.h>
#include <net/socket.h>
#include <net/coap.h>
#include "test_coap.h"


#define COAP_HOST "172.16.15.14"
#define COAP_PORT 5683
#define COAP_PAYLOAD "Hello there, I'm sent via CoAP and I'm a really long CoAP message long long and way beyond 80 characters that will break"
#define COAP_PATH "coap/zephyr20/broken"

char payload[100];

void testCoAP()
{
#define CBUF_LEN 200
    char cbuffer[CBUF_LEN];
    int err;
    int sock = socket(AF_INET, SOCK_DGRAM, IPPROTO_UDP);
    if (sock < 0)
    {
        LOG_ERR("Error opening socket: %d", sock);
        return;
    }

    LOG_INF("Sending CoAP packet");
    static struct sockaddr_in remote_addr = {
        sin_family : AF_INET,
        sin_port : htons(COAP_PORT),
    };
    net_addr_pton(AF_INET, COAP_HOST, &remote_addr.sin_addr);
    err = connect(sock, (struct sockaddr *)&remote_addr, sizeof(remote_addr));
    if (err < 0)
    {
        LOG_ERR("Unable to connect to backend: %d", err);
        close(sock);
        return;
    }

    struct coap_packet p;
    coap_packet_init(&p, payload, sizeof(payload), 1, COAP_TYPE_CON, 8, coap_next_token(), COAP_METHOD_POST, coap_next_id());
    coap_packet_append_option(&p, COAP_OPTION_URI_PATH, COAP_PATH, strlen(COAP_PATH));
    coap_packet_append_payload_marker(&p);
    coap_packet_append_payload(&p, (u8_t *)COAP_PAYLOAD, strlen(COAP_PAYLOAD));

    err = send(sock, p.data, p.offset, 0);
    if (err < 0)
    {
        LOG_ERR("Error sending CoAP packet to backend: %d", err);
        close(sock);
        return;
    }
    LOG_INF("CoAP packet sent (%d bytes). Waiting for reply", p.offset);
    // Wait for ack from backend
    err = recv(sock, cbuffer, CBUF_LEN, 0);
    if (err < 0)
    {
        LOG_ERR("Error calling recv(): %d", err);
        close(sock);
        return;
    }

    err = coap_packet_parse(&p, cbuffer, err, NULL, 0);
    if (err < 0)
    {
        LOG_ERR("Error parsing CoAP response: %d", err);
        close(sock);
        return;
    }
    LOG_INF("Response: %02x", coap_header_get_code(&p));
    close(sock);
}
```

## src/test_coap.h
```c
#pragma once

void testCoAP();
```

## src/test_modem.c
```c
#include "config.h"
#include <logging/log.h>
#define LOG_LEVEL APP_LOG_LEVEL
LOG_MODULE_REGISTER(modem_test);

#include <zephyr.h>
#include <stdio.h>


#include "comms.h"
#include "at_commands.h"

#include "test_modem.h"

static int received = 0;
static void recv_cb(int sockfd, size_t len)
{
    LOG_INF("Got %d bytes on socket %d", len, sockfd);
    received = len;
}


void testModem()
{
    int sockfd = -1;

    receive_callback(recv_cb);

    modem_write("AT+NSOCR=\"DGRAM\",17,6001,1\r");
    if (atnsocr_decode(&sockfd) != AT_OK)
    {
        LOG_ERR("Unable to decode nsocr");
        return;
    }
    modem_write("ATI\r");
    atnsocl_decode();

    modem_write("AT+NSOST=0,\"172.16.15.14\",1234,6,\"AABBAAAABBAA\"\r");
    int fd = -1;
    size_t size = 0;
    if (atnsost_decode(&fd, &size) != AT_OK)
    {
        LOG_ERR("NSOS sent error nsost");
        return;
    }
    LOG_INF("Message sent (fd=%d,len=%d), waiting for response", fd, size);

    while (received == 0)
    {
        k_sleep(1000);
    }
    char ip[32];
    char data[34];
    int port;
    memset(data, 0, sizeof(data));
    size_t received;
    size_t remaining;
    modem_write("AT+NSORF=0,32\r");
    if (atnsorf_decode(&sockfd, (char *)&ip, &port, (uint8_t *)&data, &received, &remaining) != AT_OK)
    {
        LOG_ERR("Unable to decode nsorf");
    }

    modem_write("AT+NSOCL=0\r");
    if (atnsocl_decode() != AT_OK)
    {
        LOG_ERR("Unable to decode nsocl");
    }
}
```

## src/test_modem.h
```c
#pragma once

void testModem();
```

## src/test_udp.c
```c
#include "config.h"
#include <zephyr.h>
#include <stdio.h>
#include <net/socket.h>
#include "test_udp.h"

#define MDM_MAX_SOCKETS 7

void testUDPCounter()
{
    printf("Counting bytes\n");
    int err;

    int sock = socket(AF_INET, SOCK_DGRAM, IPPROTO_UDP);
    if (sock < 0)
    {
        printf("Error opening socket: %d\n", sock);
        return;
    }

    static struct sockaddr_in remote_addr = {
        sin_family : AF_INET,
    };
    remote_addr.sin_port = htons(1234);

    net_addr_pton(AF_INET, "172.16.15.14", &remote_addr.sin_addr);

    err = connect(sock, (struct sockaddr *)&remote_addr, sizeof(remote_addr));
    if (err < 0)
    {
        printf("Unable to connect to backend: %d\n", err);
        close(sock);
        return;
    }

    char buffer[255];
    char dump[512];
    memset(dump, 0, sizeof(dump));
    memset(buffer, 0, sizeof(buffer));
    for (int i = 0; i < sizeof(buffer); i++) {
        buffer[i] = '.';
        int len = 21 + strlen(buffer);
        sprintf(dump, "%03d bytes on the wall%s", len, buffer);

        printf("Sending %d bytes\n", len);
        err = send(sock, dump, len, 0);
        if (err < len)
        {
            printf("Error sending (%d bytes sent): %d\n", len, err);
            close(sock);
            return;
        }

        k_sleep(2000);
    }
    close(sock);
}


static char udp_message[64];
static int sockets[MDM_MAX_SOCKETS];

void close_sockets() {
    for (int i = 0; i < MDM_MAX_SOCKETS; i++) {
        close(sockets[i]);
    }
}

void testUDP()
{
    int err = 0;
    printf("Creating sockets\n");
    for (int i = 0; i < MDM_MAX_SOCKETS; i++) {
        sockets[i] = socket(AF_INET, SOCK_DGRAM, IPPROTO_UDP);
        if (sockets[i] < 0)
        {
            printf("Error opening socket: %d\n", err);
            close_sockets();
            return;
        }
    }

    printf("Connecting sockets\n");
    for (int i = 0; i < MDM_MAX_SOCKETS; i++) {
        static struct sockaddr_in remote_addr = {
            sin_family : AF_INET,
        };
        remote_addr.sin_port = htons(1234);

        net_addr_pton(AF_INET, "172.16.15.14", &remote_addr.sin_addr);

        err = connect(sockets[i], (struct sockaddr *)&remote_addr, sizeof(remote_addr));
        if (err < 0)
        {
            printf("Unable to connect to backend: %d\n", err);
            close_sockets();
            return;
        }
    }

    printf("Sending messages\n");
    for (int i = 0; i < MDM_MAX_SOCKETS; i++) {
        sprintf(udp_message, "Hello this is socket %d", i);
        err = send(sockets[i], udp_message, strlen(udp_message), 0);
        if (err < strlen(udp_message))
        {
            printf("Error sending: %d\n", err);
            close_sockets();
            return;
        }
    }

    memset(udp_message, 0, sizeof(udp_message));

    printf("Polling\n");

    // Poll all sockets
    bool data = false;
    while (!data) {
        struct pollfd polls[MDM_MAX_SOCKETS];
        for (int i = 0; i < MDM_MAX_SOCKETS; i++) {
            polls[i].fd = sockets[i];
            polls[i].events = POLLIN|POLLOUT;
        }
        err = poll(polls, MDM_MAX_SOCKETS, 1000);
        if (err < 0) {
            printf("Error polling: %d\n", err);
            close_sockets();
            return;
        }
        for (int i = 0; i < MDM_MAX_SOCKETS; i++) {
            if ((polls[i].revents & POLLIN) == POLLIN) {
                printf("Got data on socket fd=%d\n", sockets[i]);
                memset(udp_message, 0, sizeof(udp_message));
                err = recv(sockets[i], udp_message, sizeof(udp_message), 0);
                if (err < 0) {
                    printf("Error receiving on socket %d: %d\n", i, err);
                    close_sockets();
                    return;
                }
                printf("Received %d bytes (%s) on socket %d\n", err, udp_message, sockets[i]);
                data = true;
            }
        }
    }
    close_sockets();

    printf("UDP test complete\n");
}
```

## src/test_udp.h
```c
#pragma once

void testUDP();
void testUDPCounter();
```
